## boards/arm/zgm_002/Kconfig.zgm_002
```kconfig
# Copyright (c) 2020 Alexander Kozhinov <ak.alexander.kozhinov@gmail.com>
# SPDX-License-Identifier: Apache-2.0

config BOARD_ZGM_002
	select SOC_STM32H723XX
    select USE_STM32_LL_TIM
	select USE_STM32_LL_RCC
    select USE_STM32_LL_ADC    


     

config MOTOR1_ENABLED
    bool "Motor1 Enabled"
    help
      Enable motor1 device node
```

## boards/arm/zgm_002/board.yml
```yaml
board:
  name: zgm_002
  full_name: Nucleo H723ZG
  vendor: st
  socs:
    - name: stm32h723xx
```

## drivers/gpio/Kconfig.tca9539
```kconfig
# TCA9539 GPIO configuration options

# Copyright (c) 2016 Intel Corporation
# SPDX-License-Identifier: Apache-2.0

menuconfig GPIO_TCA9539
	bool "TCA9539 I2C-based GPIO chip"
	default y
	depends on DT_HAS_TI_TCA9539_ENABLED
	depends on I2C
	help
	  Enable driver for TCA9539 I2C-based GPIO chip.
config GPIO_TCA9539_INIT_PRIORITY
	int "Init priority"
	default 70
	depends on GPIO_TCA9539
	help
	  Device driver initialization priority.

config GPIO_TCA9539_INTERRUPT
	bool "Interrupt enable"
	depends on GPIO_TCA9539
	help
	  Enable interrupt support in TCA9539 driver.
	  Note that the TCA9539 cannot reliably detect
	  short-pulse interrupts due to its design.
```

## dts/bindings/zgm_002/drivers/feedback/st,feedback.yaml
```yaml
description: BLDC 电机编码器

compatible: "st-feedback"

include: [base.yaml]

properties:
  feedback:    
    type: phandle
    required: true 
    description: Motor Encoder          
```

## dts/bindings/zgm_002/drivers/feedback/st,stm32-abz-hall.yaml
```yaml
# Copyright (c) 2021, Teslabs Engineering S.L.
# SPDX-License-Identifier: Apache-2.0

description: |
  ABZ sensor driver for STM32 microcontrollers.

  The ABZ device is expected to be a children of any STM32 timer supporting
  the ABZ interface. Example usage:

      &timers2 {
        status = "okay";

        feedback: feedback {
            compatible = "st,stm32-abz";

            pinctrl-0 = <&tim2_ch1_pa15 &tim2_ch2_pb3>;
            pinctrl-names = "default";

            lines = <4096>;
            pole-pairs = <15>;
        };
      };

compatible: "st,abz-hall"

include: [base.yaml, pinctrl-device.yaml]

properties:
  pinctrl-0:
    required: true

  pinctrl-names:
    required: true

  lines:
    type: int
    default: 4096
    description: |
      number of encoder lines

  pole-pairs:
    type: int
    default: 15
    description: |
      number of encoder pole pairs

  hu-gpios:
    type: phandle-array
    required: true
  hv-gpios:
    type: phandle-array
    required: true    
  hw-gpios:
    type: phandle-array
    required: true
```

## dts/bindings/zgm_002/drivers/feedback/st,stm32-hall.yaml
```yaml
description: STM32 Hall Sensor Configuration

compatible: "st,stm32-hall"
include: [base.yaml, pinctrl-device.yaml]
properties:
  hu-gpios:
    type: phandle-array
    required: true
  hv-gpios:
    type: phandle-array
    required: true    
  hw-gpios:
    type: phandle-array
    required: true    

description: Hall sensor phase configuration
```

## dts/bindings/zgm_002/drivers/pwm/pwm_stm32.yaml
```yaml
# Copyright (c) 2021, Teslabs Engineering S.L.
# SPDX-License-Identifier: Apache-2.0

description: |
  STM32S PWM device with unified timing parameters.

compatible: "st,stm32-pwm-custom"

include: [base.yaml, pinctrl-device.yaml]

properties:
  pinctrl-0:
    required: true
  pinctrl-names:
    required: true
  timing-params:
    type: array
    required: true
    description: |
      PWM timing parameters array:
      Index 0 - t_dead_ns (dead time in nanoseconds)
      Index 1 - arr (auto-reload value)
      Index 2 - psc (prescaler value)
  slave:
    type: int
    required: true
    description: Slave mode enable flag
```
